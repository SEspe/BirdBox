## sdkconfig.defaults
```kconfig
# Common defaults for all targets. Target-specific values live in
# sdkconfig.defaults.esp32s3 / sdkconfig.defaults.esp32 (applied automatically
# by idf.py after this file).
CONFIG_PARTITION_TABLE_CUSTOM=y

CONFIG_ESP_MAIN_TASK_STACK_SIZE=8192
CONFIG_ESP_SYSTEM_EVENT_TASK_STACK_SIZE=4096

# httpd tuning (FSD §4.7): generous header/URI limits for the embedded UI
CONFIG_HTTPD_MAX_REQ_HDR_LEN=4096
CONFIG_HTTPD_MAX_URI_LEN=512

CONFIG_BOOTLOADER_LOG_LEVEL_WARN=y

CONFIG_ESP_WIFI_STATIC_RX_BUFFER_NUM=10
CONFIG_ESP_WIFI_DYNAMIC_RX_BUFFER_NUM=32

# FAT long filenames for /captures/YYYY-MM-DD/HHMMSS_seq.jpg (FSD §7)
CONFIG_FATFS_LFN_HEAP=y

# OTA rollback (FSD §8): an image that never confirms itself valid via
# esp_ota_mark_app_valid_cancel_rollback() (main.c) gets rolled back to the
# previous slot on the next boot — a bad OTA upload can't brick the device.
CONFIG_BOOTLOADER_APP_ROLLBACK_ENABLE=y

# HTTPS OTA from GitHub releases (FSD §8): the device downloads+flashes a
# release asset itself over TLS (the browser can't, no CORS on the asset host).
# CA bundle validates GitHub's cert; dynamic buffers keep the TLS heap peak
# small. TLS buffers stay in internal DRAM (~180 KB free, measured) — plenty.
CONFIG_MBEDTLS_CERTIFICATE_BUNDLE=y
CONFIG_MBEDTLS_CERTIFICATE_BUNDLE_DEFAULT_FULL=y
CONFIG_MBEDTLS_DYNAMIC_BUFFER=y
CONFIG_ESP_TLS_INSECURE=n
# Required, not optional, for api.anthropic.com (FSD §3.2.3) — and it defaults
# to n, so this line is the whole reason outbound HTTPS works at all.
#
# api.anthropic.com serves leaf -> GTS WE1 -> GTS Root R4, where the R4 it
# sends is CROSS-SIGNED by GlobalSign Root CA. Without this option the bundle
# cannot walk a chain whose root is cross-signed and its callback returns
# MBEDTLS_ERR_X509_FATAL_ERROR (-0x3000) *without setting any cert-verify
# flag* — so the failure surfaces as ESP_ERR_HTTP_CONNECT with certflags
# 0x00000000, which reads exactly like "the certificate was fine" and sends
# you hunting the network instead. Costs ~700 B of heap.
#
# Not Anthropic-specific: anything behind Google Trust Services (i.e. a large
# share of the internet) presents the same cross-signed shape, so don't
# "clean this up" when swapping API vendors.
CONFIG_MBEDTLS_CERTIFICATE_BUNDLE_CROSS_SIGNED_VERIFY=y

# Larger httpd socket pool (FSD v2.13): default 10 caps max_open_sockets at 7;
# 16 allows the httpd pool of 12 that stops fresh requests stalling to purge a
# stale socket. Requires deleting the generated sdkconfig to take effect.
CONFIG_LWIP_MAX_SOCKETS=16

# Standalone heap tracing (FSD v2.50), for the outbound-HTTPS leak: every TLS
# handshake leaves ~10-15 small INTERNAL-DRAM blocks that neither close() nor
# cleanup() returns, shattering free space until the handshake can no longer get
# a contiguous buffer and ALL classification stops after ~6 h. Byte-level stats
# cannot name the culprit; HEAP_TRACE_LEAKS keeps a record of every still-live
# allocation WITH its call stack, which does. Stack depth 6 so the trace reaches
# past the mbedTLS/esp-tls wrappers into the actual caller.
# Left OFF: tracing costs ~20 KB of internal DRAM (record buffer + per-malloc
# bookkeeping), which is exactly the resource under investigation. To hunt a
# leak again, uncomment these three, delete sdkconfig, rebuild, then drive
# /api/heaptrace?a=start|stop|dump (the endpoint compiles only with tracing on).
#CONFIG_HEAP_TRACING_STANDALONE=y
#CONFIG_HEAP_TRACING=y
#CONFIG_HEAP_TRACING_STACK_DEPTH=6
```
